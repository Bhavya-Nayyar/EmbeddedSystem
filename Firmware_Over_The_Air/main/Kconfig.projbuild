## Firmware_Over_The_Air/main/Kconfig.projbuild
```kconfig
menu "WiFi OTA Configuration"

    config WIFI_SSID
        string "WiFi SSID"
        default "myssid"

    config WIFI_PASSWORD
        string "WiFi Password"
        default "mypassword"

    config OTA_FIRMWARE_URL
        string "OTA firmware URL"
        default "http://192.168.1.100:8000/firmware.bin"

endmenu
```
